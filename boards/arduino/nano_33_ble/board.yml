## boards/arduino/nano_33_ble/board.yml
```yaml
board:
  name: arduino_nano_33_ble_rev2
  full_name: Arduino Nano 33 BLE (Sense rev2)
  vendor: arduino
  socs:
  - name: nrf52840
    variants:
    - name: 'sense'
    
    
```

## west.yml
```yaml
# Copyright (c) Loic Domaigne
# SPDX-License-Identifier: Apache-2.0

manifest:

  remotes:
    - name: zephyrproject-rtos
      url-base: https://github.com/zephyrproject-rtos

  projects:
    - name: zephyr
      remote: zephyrproject-rtos
      revision: v4.4.2
      import:
        # By using name-allowlist we can clone only the modules that are
        # strictly needed by the application.
        name-allowlist:
          - cmsis_6    # required by the ARM port for Cortex-M
          - hal_nordic # required by the Nana BLE Sense board
    - name: zscilib
      remote: zephyrproject-rtos
      revision: master
      path: modules/zscilib
```
